## firmware/sdkconfig.defaults
```kconfig
# Huxley firmware — curated build defaults.
# Checked in so every developer's build produces the same binary.
# Run `idf.py reconfigure` after editing.
#
# Target is set out-of-band via `idf.py set-target esp32s3` (stored in
# the generated sdkconfig, not here, to avoid collisions with target
# selection).

# -- Flash + partitioning ------------------------------------------------
# Board ships with 16 MB flash. Dual-OTA layout reserved from day 1 so
# adding OTA later is additive, not a reflash migration.
CONFIG_ESPTOOLPY_FLASHSIZE_16MB=y
CONFIG_PARTITION_TABLE_CUSTOM=y
CONFIG_PARTITION_TABLE_CUSTOM_FILENAME="partitions.csv"

# -- PSRAM (Octal, 8 MB on this board) -----------------------------------
CONFIG_SPIRAM=y
CONFIG_SPIRAM_MODE_OCT=y
CONFIG_SPIRAM_SPEED_80M=y
CONFIG_SPIRAM_USE_MALLOC=y
CONFIG_SPIRAM_TRY_ALLOCATE_WIFI_LWIP=y
# Force small allocations (< 16 KB) to internal SRAM — PSRAM is for large
# audio ring buffers, not every tiny heap allocation. Note: this only
# affects heap allocations; static BSS stays internal unless explicitly
# marked with `EXT_RAM_BSS_ATTR` (enabled below).
CONFIG_SPIRAM_MALLOC_ALWAYSINTERNAL=16384
# Allow explicit BSS-in-PSRAM via `EXT_RAM_BSS_ATTR` so large static
# scratch buffers (base64 decode, future playback ring) don't
# squeeze internal RAM reserved for DMA and FreeRTOS task stacks.
CONFIG_SPIRAM_ALLOW_BSS_SEG_EXTERNAL_MEMORY=y

# -- Serial / boot -------------------------------------------------------
# Native USB-CDC so `idf.py monitor` works through the Type-C port without
# a separate UART bridge.
CONFIG_ESP_CONSOLE_USB_SERIAL_JTAG=y

# -- Logging -------------------------------------------------------------
# Runtime default stays at INFO. Compile-time ceiling raised to DEBUG so
# `esp_log_level_set("<tag>", ESP_LOG_DEBUG)` at runtime actually emits
# — with MAXIMUM=DEFAULT the DEBUG calls are compiled out entirely.
CONFIG_LOG_DEFAULT_LEVEL_INFO=y
# CONFIG_LOG_MAXIMUM_EQUALS_DEFAULT is not set
CONFIG_LOG_MAXIMUM_LEVEL_DEBUG=y

# -- Core dumps to flash (panic -> dedicated partition) ------------------
# Decoded on host with `python -m esp_coredump info_corefile` — see
# firmware/docs/debugging.md.
CONFIG_ESP_COREDUMP_ENABLE_TO_FLASH=y
CONFIG_ESP_COREDUMP_DATA_FORMAT_ELF=y
CONFIG_ESP_COREDUMP_CHECKSUM_CRC32=y
CONFIG_ESP_COREDUMP_LOGS=y

# -- FreeRTOS ------------------------------------------------------------
# 1000 Hz tick so audio frame pacing (20 ms) is a whole number of ticks.
CONFIG_FREERTOS_HZ=1000

# -- Network / Wi-Fi -----------------------------------------------------
CONFIG_ESP_WIFI_ENABLE_WPA3_SAE=y

# -- LWIP / TCP ----------------------------------------------------------
# 50 Hz audio × 1.3 KB/frame = 65 KB/s of outbound burst, plus
# inbound audio chunks during model speech. Tuned for sustained
# bidirectional WS audio load.
CONFIG_LWIP_TCP_SND_BUF_DEFAULT=65535
CONFIG_LWIP_TCP_WND_DEFAULT=65535
CONFIG_LWIP_WND_SCALE=y
CONFIG_LWIP_TCP_RCV_SCALE=4
# `LWIP_TCPIP_CORE_LOCKING` lets the lwIP TCP/IP thread share its
# critical-section work with calling tasks instead of marshalling
# every API call through a mailbox. Big throughput / latency win for
# our 50 Hz send pattern. Espressif's lwIP perf guide recommends
# this for sustained-traffic apps.
CONFIG_LWIP_TCPIP_CORE_LOCKING=y

# -- esp_websocket_client (managed component) ---------------------------
# Separate TX/RX locks (added in component v1.5.0 via
# espressif/esp-protocols PR #704). Without it, the writer serialises
# against the receive task even when the TCP send window is open,
# producing the `transport_poll_write(0)` close-on-timeout we hit in
# v0.3.1. With it, send and receive proceed independently — required
# for any bidirectional audio workload over WS.
CONFIG_ESP_WS_CLIENT_SEPARATE_TX_LOCK=y

# -- Compiler ------------------------------------------------------------
CONFIG_COMPILER_OPTIMIZATION_PERF=y
CONFIG_COMPILER_WARN_WRITE_STRINGS=y
```
